## conf/layer.conf
```bitbake
# We have a conf and classes directory, add to BBPATH
BBPATH .= ":${LAYERDIR}"

# We have a recipes-* directories, add to BBFILES
BBFILES += "${LAYERDIR}/recipes-*/*/*.bb \
	${LAYERDIR}/recipes-*/*/*.bbappend"

BBFILE_COLLECTIONS += "engicam-st"
BBFILE_PATTERN_engicam-st := "^${LAYERDIR}/"
BBFILE_PRIORITY_engicam-st = "7"

EULA_FILE_ST:stm32mpcommon = "${LAYERDIR}/conf/eula/${MACHINE}"
EULA_FILE_ST_MD5SUM:stm32mpcommon = "1c485682b3ceeae0c296ba593235bd69"

# Set a variable to get the STM32MP BSP location
STM32MP_BASE = "${LAYERDIR}"

# This should only be incremented on significant changes that will
# cause compatibility issues with other layers
LAYERVERSION_engicam-st = "1"
LAYERSERIES_COMPAT_engicam-st = "mickledore"

# for optee-os-stm32mp dependency
LAYERDEPENDS_engicam-st = "core openembedded-layer meta-python stm-st-stm32mp"

# OpenSTLinux compatibility version
ST_OSTL_COMPATIBILITY_VERSION_engicam-st = "5.1"
```

## conf/machine/geastm32.inc
```bitbake
#@TYPE: Machine
#@NAME: stm32mp1-ugea
#@DESCRIPTION: Configuration for ugea board with 256MB RAM
#@NEEDED_BSPLAYERS: meta-engicam-st

include conf/machine/include/st-machine-common-stm32mp.inc
include conf/machine/include/st-machine-providers-stm32mp.inc

# Define specific familly common machine name
MACHINEOVERRIDES .= ":stm32mp1common:ugea"

# =========================================================================
# Chip architecture
# =========================================================================
DEFAULTTUNE = "cortexa7thf-neon-vfpv4"
include conf/machine/include/tune-cortexa7.inc

# =========================================================================
# boot scheme
# =========================================================================
BOOTSCHEME_LABELS += "trusted"

# =========================================================================
# Define u-boot defconfig and binary to use for each UBOOT_CONFIG
UBOOT_CONFIG[trusted] = "stm32mp15_ugeast_trusted_defconfig,,u-boot.stm32"
KERNEL_DEFCONFIG=" stm32mp1ugea_defconfig"

# =========================================================================

# =========================================================================
# boot device
# =========================================================================
# Define the boot device supported
#BOOTDEVICE_LABELS += "emmc"
#BOOTDEVICE_LABELS += "nand-4-256"
BOOTDEVICE_LABELS += "sdcard"

# =========================================================================
# Machine settings
# =========================================================================
#STM32MP_DT_FILES_EV += " stm32mp157a-ugeast-mx "
STM32MP_DT_FILES_ED += " stm32mp157a-ugeast-mx "

# =========================================================================
# Machine features
# =========================================================================
MACHINE_FEATURES += "splashscreen"
MACHINE_FEATURES += "watchdog"
MACHINE_FEATURES += "bluetooth"
MACHINE_FEATURES += "wifi"
MACHINE_FEATURES += "${@'gpu' if d.getVar('ACCEPT_EULA_'+d.getVar('MACHINE')) == '1' else ''}"
MACHINE_FEATURES += "m4copro"

# Bluetooth
BLUETOOTH_LIST += "linux-firmware-bluetooth-bcm4343"
# Wifi
WIFI_LIST += "linux-firmware-bcm43430"

EXTLINUX_ROOT_EMMC         = "root=/dev/mmcblk1p4"
EXTLINUX_ROOT_EMMC_OPTEE   = "root=/dev/mmcblk1p7"
EXTLINUX_ROOT_NAND         = "ubi.mtd=UBI rootfstype=ubifs root=ubi0:rootfs"
EXTLINUX_ROOT_NOREMMC      = "root=/dev/mmcblk1p3"
EXTLINUX_ROOT_NORSDCARD    = "root=/dev/mmcblk0p3"
EXTLINUX_ROOT_SDCARD       = "root=/dev/mmcblk0p6"
EXTLINUX_ROOT_SDCARD_OPTEE = "root=/dev/mmcblk0p9"

KERNEL_DEVICETREE = "\
			stm32mp157a-ugeast-mx.dtb \
			stm32mp157a-ugeast-mx-lcd7.dtb \
			stm32mp157a-ugeast-mx-m4.dtb \
"

UBOOT_EXTLINUX_TARGETS = "mp157a-ugeast-mx-lcd7 mp157a-ugeast-mx mp157a-ugeast-mx-m4"
UBOOT_EXTLINUX_LABELS = "mp157a-ugeast-mx-lcd7 mp157a-ugeast-mx mp157a-ugeast-mx-m4"

UBOOT_EXTLINUX_DEFAULT_LABEL = "stm32mp157a-ugeast-mx-lcd7"

UBOOT_EXTLINUX_MENU_DESCRIPTION_mp157a-ugeast-mx-lcd7 = "stm32mp157a-ugeast-mx-lcd7"
UBOOT_EXTLINUX_FDT_mp157a-ugeast-mx-lcd7 = "/stm32mp157a-ugeast-mx-lcd7.dtb"
UBOOT_EXTLINUX_MENU_DESCRIPTION_mp157a-ugeast-mx = "stm32mp157a-ugeast-mx"
UBOOT_EXTLINUX_FDT_mp157a-ugeast-mx = "/stm32mp157a-ugeast-mx.dtb"
UBOOT_EXTLINUX_MENU_DESCRIPTION_mp157a-ugeast-mx-m4 = "stm32mp157a-ugeast-mx-m4"
UBOOT_EXTLINUX_FDT_mp157a-ugeast-mx-m4 = "/stm32mp157a-ugeast-mx-m4.dtb"
```

## conf/machine/icorestm32.inc
```bitbake
#@TYPE: Machine
#@NAME: stm32mp1-ugea
#@DESCRIPTION: Configuration for ugea board with 256MB RAM
#@NEEDED_BSPLAYERS: meta-engicam-st

include conf/machine/include/st-machine-common-stm32mp.inc
include conf/machine/include/st-machine-providers-stm32mp.inc

# Define specific familly common machine name
MACHINEOVERRIDES .= ":stm32mp1common:icore"

# =========================================================================
# Chip architecture
# =========================================================================
DEFAULTTUNE = "cortexa7thf-neon-vfpv4"
include conf/machine/include/tune-cortexa7.inc

# =========================================================================
# boot scheme
# =========================================================================
BOOTSCHEME_LABELS += "trusted"

# =========================================================================
# Define u-boot defconfig and binary to use for each UBOOT_CONFIG
#UBOOT_CONFIG[trusted] = "stm32mp15_ugeast_trusted_defconfig,,u-boot.stm32"
KERNEL_DEFCONFIG=" stm32mp1_defconfig"

# =========================================================================

# =========================================================================
# boot device
# =========================================================================
# Define the boot device supported
#BOOTDEVICE_LABELS += "emmc"
#BOOTDEVICE_LABELS += "nand-4-256"
BOOTDEVICE_LABELS += "sdcard"

# =========================================================================
# Machine settings
# =========================================================================
#STM32MP_DT_FILES_EV += " stm32mp157a-icorestm32-mx "
#STM32MP_DT_FILES_ED += " stm32mp157a-icorest-mx "

# =========================================================================
# Machine features
# =========================================================================
MACHINE_FEATURES += "splashscreen"
MACHINE_FEATURES += "watchdog"
MACHINE_FEATURES += "bluetooth"
MACHINE_FEATURES += "wifi"
MACHINE_FEATURES += "${@'gpu' if d.getVar('ACCEPT_EULA_'+d.getVar('MACHINE')) == '1' else ''}"
MACHINE_FEATURES += "m4copro"

# Bluetooth
BLUETOOTH_LIST += "linux-firmware-bluetooth-bcm4343"
# Wifi
WIFI_LIST += "linux-firmware-bcm43430"

EXTLINUX_ROOT_EMMC         = "root=/dev/mmcblk1p4"
EXTLINUX_ROOT_EMMC_OPTEE   = "root=/dev/mmcblk1p7"
EXTLINUX_ROOT_NAND         = "ubi.mtd=UBI rootfstype=ubifs root=ubi0:rootfs"
EXTLINUX_ROOT_NOREMMC      = "root=/dev/mmcblk1p3"
EXTLINUX_ROOT_NORSDCARD    = "root=/dev/mmcblk0p3"
EXTLINUX_ROOT_SDCARD       = "root=/dev/mmcblk0p6"
EXTLINUX_ROOT_SDCARD_OPTEE = "root=/dev/mmcblk0p9"

KERNEL_DEVICETREE = "\
			stm32mp157a-icore-lvds-mx.dtb \
			stm32mp157a-icore-ofcap2-10-mx.dtb \
"

UBOOT_EXTLINUX_TARGETS = "mp157a-icorest-mx-starterkit mp157a-icorest-mx-ofcap2-10"
UBOOT_EXTLINUX_LABELS = "mp157a-icorest-mx-starterkit mp157a-icorest-mx-ofcap2-10"

UBOOT_EXTLINUX_DEFAULT_LABEL = "stm32mp157a-icorest-lvds-mx"

UBOOT_EXTLINUX_MENU_DESCRIPTION_mp157a-icorest-mx-starterkit = "stm32mp157a-icore-lvds-mx"
UBOOT_EXTLINUX_FDT_mp157a-icorest-mx-starterkit = "/stm32mp157a-icore-lvds-mx.dtb"
UBOOT_EXTLINUX_MENU_DESCRIPTION_mp157a-icorest-mx-ofcap2-10 = "stm32mp157a-icore-ofcap2-10-mx"
UBOOT_EXTLINUX_FDT_mp157a-icorest-mx-ofcap2-10 = "/stm32mp157a-icore-ofcap2-10-mx.dtb"
```

## conf/machine/stm32mp1-icore.conf
```bitbake
#@TYPE: Machine
#@NAME: stm32mp1
#@DESCRIPTION: Configuration for all STM32MP1 boards (EV, DK, ...)
#@NEEDED_BSPLAYERS: layers/meta-openembedded/meta-oe layers/meta-openembedded/meta-python

include conf/machine/include/st-machine-common-stm32mp.inc
include conf/machine/include/st-machine-providers-stm32mp.inc

# Define specific familly common machine name
MACHINEOVERRIDES .= ":stm32mp1common"

# =========================================================================
# SOC
# =========================================================================
STM32MP_SOC_NAME = "stm32mp15"

# =========================================================================
# Chip architecture
# =========================================================================
DEFAULTTUNE = "cortexa7thf-neon-vfpv4"
include conf/machine/include/tune-cortexa7.inc

# =========================================================================
# boot scheme
# =========================================================================
BOOTSCHEME_LABELS += "trusted"

# =========================================================================
# boot device
# =========================================================================
# Define the boot device supported
BOOTDEVICE_LABELS += "emmc"
BOOTDEVICE_LABELS += "nand-4-256"
BOOTDEVICE_LABELS += "sdcard"

# =========================================================================
# Machine settings
# =========================================================================
# Define list of devicetree per board
STM32MP_DT_FILES_DK += "stm32mp157a-icore-starterkit-mx stm32mp157a-icore-ctouch2-amp10-mx"
STM32MP_DT_FILES_ED += "stm32mp157a-icore-starterkit-mx stm32mp157a-icore-ctouch2-amp10-mx"

# =========================================================================
# Machine features
# =========================================================================
MACHINE_FEATURES += "splashscreen"
MACHINE_FEATURES += "watchdog"
MACHINE_FEATURES += "bluetooth"
MACHINE_FEATURES += "wifi"
MACHINE_FEATURES += "${@'gpu' if d.getVar('ACCEPT_EULA_'+d.getVar('MACHINE')) == '1' else ''}"
MACHINE_FEATURES += "m4copro"

# Bluetooth
BLUETOOTH_LIST += "linux-firmware-bluetooth-bcm4343"
# Wifi
WIFI_LIST += "linux-firmware-bcm43430"

UBOOT_EXTLINUX_TARGETS_EXTRA_CONFIG[stm32mp157a-icore-starterkit-mx] += "stm32mp157a-icore-starterkit-mx"
UBOOT_EXTLINUX_TARGETS_EXTRA_CONFIG[stm32mp157a-icore-ctouch2-amp10-mx] += "stm32mp157a-icore-ctouch2-amp10-mx"
UBOOT_EXTLINUX_FDT_stm32mp157a-icore-starterkit-mx = "/stm32mp157a-icore-starterkit-mx.dtb"
UBOOT_EXTLINUX_FDT_stm32mp157a-icore-ctouch2-amp10-mx = "/stm32mp157a-icore-ctouch2-amp10-mx.dtb"
```

## conf/machine/stm32mp1-icorestm32.conf
```bitbake
#@TYPE: Machine
#@NAME: icore-stm32mp
#@DESCRIPTION: Configuration for icorestm32mp1 board (Trusted boot and SDcard only)
#@NEEDED_BSPLAYERS: meta-engicam-st

include conf/machine/icorestm32.inc

# Define u-boot defconfig and binary to use for each UBOOT_CONFIG
UBOOT_CONFIG[trusted] = "stm32mp15_icorest_trusted_defconfig,,u-boot.stm32"

STM32MP_DT_FILES_DK += "stm32mp157a-icorestm32-mx"

UBOOT_EXTLINUX_ROOT = "${EXTLINUX_ROOT_SDCARD}"
#UBOOT_EXTLINUX_ROOT = "${EXTLINUX_ROOT_NAND}"
#UBOOT_EXTLINUX_ROOT = "${EXTLINUX_ROOT_EMMC}"
```

## conf/machine/stm32mp1-ugea-512.conf
```bitbake
#@TYPE: Machine
#@NAME: stm32mp1-ugea
#@DESCRIPTION: Configuration for ugea board with 512MB RAM
#@NEEDED_BSPLAYERS: meta-engicam-st

include conf/machine/geastm32.inc

# Define u-boot defconfig and binary to use for each UBOOT_CONFIG
UBOOT_CONFIG[trusted] = "stm32mp15_ugeast_512_trusted_defconfig,,u-boot.stm32"

STM32MP_DT_FILES_ED += "stm32mp157a-ugeast-512-mx"

UBOOT_EXTLINUX_ROOT = "${EXTLINUX_ROOT_SDCARD}"
#UBOOT_EXTLINUX_ROOT = "${EXTLINUX_ROOT_NAND}"
#UBOOT_EXTLINUX_ROOT = "${EXTLINUX_ROOT_EMMC}"
```

## conf/machine/stm32mp1-ugea-lcd7.conf
```bitbake
#@TYPE: Machine
#@NAME: stm32mp1-ugea
#@DESCRIPTION: Configuration for ugea board with 256MB RAM
#@NEEDED_BSPLAYERS: meta-engicam-st

include conf/machine/include/st-machine-common-stm32mp.inc
include conf/machine/include/st-machine-providers-stm32mp.inc

# Define specific familly common machine name
MACHINEOVERRIDES .= ":stm32mp1common:ugea"

# =========================================================================
# Chip architecture
# =========================================================================
DEFAULTTUNE = "cortexa7thf-neon-vfpv4"
include conf/machine/include/tune-cortexa7.inc

# =========================================================================
# boot scheme
# =========================================================================
BOOTSCHEME_LABELS += "trusted"

# =========================================================================
# Define u-boot defconfig and binary to use for each UBOOT_CONFIG
UBOOT_CONFIG[trusted] = "stm32mp15_ugeast_trusted_defconfig,,u-boot.stm32"
KERNEL_DEFCONFIG=" stm32mp1ugea_defconfig"

# =========================================================================

# =========================================================================
# boot device
# =========================================================================
# Define the boot device supported
BOOTDEVICE_LABELS += "emmc"
BOOTDEVICE_LABELS += "nand-4-256"
BOOTDEVICE_LABELS += "sdcard"

# =========================================================================
# Machine settings
# =========================================================================
#STM32MP_DT_FILES_EV += " stm32mp157a-ugeast-mx "
STM32MP_DT_FILES_ED += " stm32mp157a-ugeast-mx "


# =========================================================================
# Machine features
# =========================================================================
MACHINE_FEATURES += "splashscreen"
MACHINE_FEATURES += "watchdog"
MACHINE_FEATURES += "bluetooth"
MACHINE_FEATURES += "wifi"
MACHINE_FEATURES += "${@'gpu' if d.getVar('ACCEPT_EULA_'+d.getVar('MACHINE')) == '1' else ''}"
MACHINE_FEATURES += "m4copro"

KERNEL_DEVICETREE = "\
					stm32mp157a-ugeast-mx.dtb \
					stm32mp157a-ugeast-mx-lcd7.dtb \
					"

UBOOT_EXTLINUX_MENU_DESCRIPTION_stm32mp1-ugea-lcd7 = "stm32mp157a-ugeast-mx-lcd7"
UBOOT_EXTLINUX_FDT_stm32mp1-ugea-lcd7 = "/stm32mp157a-ugeast-mx-lcd7.dtb"
```

## conf/machine/stm32mp1-ugea.conf
```bitbake
#@TYPE: Machine
#@NAME: stm32mp1-ugea
#@DESCRIPTION: Configuration for ugea board with 256MB RAM
#@NEEDED_BSPLAYERS: meta-engicam-st

include conf/machine/geastm32.inc

# Define u-boot defconfig and binary to use for each UBOOT_CONFIG
UBOOT_CONFIG[trusted] = "stm32mp15_ugeast_trusted_defconfig,,u-boot.stm32"

STM32MP_DT_FILES_ED += "stm32mp157a-ugeast-mx"

UBOOT_EXTLINUX_ROOT = "${EXTLINUX_ROOT_SDCARD}"
#UBOOT_EXTLINUX_ROOT = "${EXTLINUX_ROOT_NAND}"
#UBOOT_EXTLINUX_ROOT = "${EXTLINUX_ROOT_EMMC}"
```
