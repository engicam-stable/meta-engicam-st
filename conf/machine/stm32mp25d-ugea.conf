## conf/machine/stm32mp25d-ugea.conf
```bitbake
#@TYPE: Machine
#@NAME: stm32mp25D-uGea
#@DESCRIPTION: Configuration for Engicam STM32MP25D uGea
#@NEEDED_BSPLAYERS: layers/meta-openembedded/meta-oe layers/meta-openembedded/meta-python

# Define specific familly common machine name
MACHINEOVERRIDES =. "stm32mp2common:stm32mp25common:"

include conf/machine/include/st-machine-common-stm32mp.inc
include conf/machine/include/st-machine-providers-stm32mp.inc

# =========================================================================
# Chip architecture
# =========================================================================
DEFAULTTUNE = "cortexa35"
include conf/machine/include/arm/armv8a/tune-cortexa35.inc

# =========================================================================
# boot scheme
# =========================================================================
BOOTSCHEME_LABELS = "optee"

# =========================================================================
# boot device
# =========================================================================
# Define the boot device supported
BOOTDEVICE_LABELS += "emmc"
BOOTDEVICE_LABELS += "nor-sdcard"
BOOTDEVICE_LABELS += "sdcard"

# =========================================================================
# Machine settings
# =========================================================================
# activate external dt
EXTERNAL_DT_ENABLED = "1"

# Define list of devicetree per supported storage
STM32MP_DT_FILES_EMMC   += "stm32mp257d-ugea-micro5-mx"
STM32MP_DT_FILES_SDCARD += "stm32mp257d-ugea-micro5-mx"

# =========================================================================
# Machine features
# =========================================================================
MACHINE_FEATURES += "splashscreen"
MACHINE_FEATURES += "watchdog"
MACHINE_FEATURES += "bluetooth"
MACHINE_FEATURES += "wifi"

# GPU
MACHINE_FEATURES += "${@'gpu' if d.getVar('ACCEPT_EULA_'+d.getVar('MACHINE')) == '1' else ''}"
MACHINE_FEATURES += "${@'openvx' if d.getVar('ACCEPT_EULA_'+d.getVar('MACHINE')) == '1' else ''}"
MACHINE_FEATURES += "${@'opencl' if d.getVar('ACCEPT_EULA_'+d.getVar('MACHINE')) == '1' else ''}"
MACHINE_FEATURES += "${@'vulkan' if d.getVar('ACCEPT_EULA_'+d.getVar('MACHINE')) == '1' else ''}"

# M33
MACHINE_FEATURES += "m33copro"

# Bluetooth
BLUETOOTH_LIST += "linux-firmware-bluetooth-bcm43xx"
# Wifi
WIFI_LIST += "linux-firmware-bcm43430"
# PCIe
PCI_LIST += "linux-firmware-rtl8168"

#Driver for PAN9028
MACHINE_FEATURES += "nxp8987-sdio"
MACHINE_EXTRA_RRECOMMENDS:append = " ${@bb.utils.contains('MACHINE_FEATURES', 'nxp8987-sdio', 'kernel-module-nxp-wlan', '', d)}"
WIFI_LIST += "firmware-nxp-wifi-nxp8987-sdio"
# ==========================================================================
# M33 Boards
# ==========================================================================
# Lists of boards/devicetree on which the m33 service MUST be started
M33_BOARDS_START_AT_STARTUP = "stm32mp257f-ev1"
M33_BOARDS_START_AT_STARTUP =+ "${@bb.utils.contains('EXTERNAL_DT_ENABLED', '1', 'stm32mp257f-ev1-ca35tdcid-ostl', '', d)}"

# =========================================================================
# OPTEE
# =========================================================================
# For sdk generation, declare the default board configuration to use.
ST_OPTEE_EXPORT_TA_REF_BOARD:stm32mp2common = "stm32mp257d-ugea-micro5-mx.dts"

# =========================================================================
# WIC for sdcard raw image
# =========================================================================
WIC_CREATE_EXTRA_ARGS = "--no-fstab-update"
WKS_FILE_DEPENDS ?= " \
    virtual/bootloader \
    virtual/trusted-firmware-a \
    virtual-optee-os \
    ${@bb.utils.contains('ST_BOOTFS','1','st-image-bootfs', '', d)} \
    ${@bb.utils.contains('ST_VENDORFS','1','st-image-vendorfs', '', d)} \
    ${@bb.utils.contains('ST_USERFS','1','st-image-userfs', '', d)} \
"
OPTEE_WIC_FILE = "${@bb.utils.contains('ST_VENDORFS','1','sdcard-stm32mp257f-ev1-optee-vendorfs-2GB.wks.in','sdcard-stm32mp257f-ev1-optee-2GB.wks.in',d)}"

# for generated a WIC file, please uncomment the 2 following lines or add them to local.conf
#WKS_IMAGE_FSTYPES += "wic wic.bz2 wic.bmap"
#WKS_FILE += "${OPTEE_WIC_FILE}"

### Custom extlinux ###
UBOOT_EXTLINUX_LABELS:target-sdcard = "ugea-micro5"
UBOOT_EXTLINUX_LABELS:target-emmc = "ugea-micro5"
UBOOT_EXTLINUX_LABELS:target-nand = "ugea-micro5"

UBOOT_EXTLINUX_FDT:ugea-micro5="/stm32mp257d-ugea-micro5-mx.dtb"

UBOOT_EXTLINUX_DEFAULT_LABEL="ugea-micro5"


# for multivolumt
ST_USERFS = "0"
ST_VENDORFS = "0"

UBOOT_EXTLINUX_SPLASH ?= "${UBOOT_SPLASH_ST_IMAGE}"

IMAGE_ROOTFS_MAXSIZE = "1536000"
```
