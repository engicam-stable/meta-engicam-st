## conf/machine/stm32mp15-ugea.conf
```bitbake
#@TYPE: Machine
#@NAME: stm32mp157a-ugea-microdev
#@DESCRIPTION: [EXAMPLE] STM32MP157F-DK2 board ONLY with Optee boot and SDcard support
#@NEEDED_BSPLAYERS: layers/meta-openembedded/meta-oe layers/meta-openembedded/meta-python

# Define specific familly common machine name
MACHINEOVERRIDES =. "stm32mp1common:stm32mp15common:"

include conf/machine/include/st-machine-common-stm32mp.inc
include conf/machine/include/st-machine-providers-stm32mp.inc

# =========================================================================
# Chip architecture
# =========================================================================
DEFAULTTUNE = "cortexa7thf-neon-vfpv4"
include conf/machine/include/arm/armv7a/tune-cortexa7.inc

# =========================================================================
# boot scheme
# =========================================================================
BOOTSCHEME_LABELS += "optee"

# =========================================================================
# boot device
# =========================================================================
# Define the boot device supported
BOOTDEVICE_LABELS += "sdcard"
BOOTDEVICE_LABELS += "nand-4-256-1024"

# =========================================================================
# Machine settings
# =========================================================================
# Define list of devicetree per supported storage
STM32MP_DT_FILES_SDCARD += "stm32mp157a-ugea-microdev-mx"
STM32MP_DT_FILES_NAND += "stm32mp157a-ugea-microdev-mx"
KERNEL_DEVICETREE += "${KERNEL_SUB_PATH}stm32mp157a-ugea-evb.dtb"

# =========================================================================
# Machine features
# =========================================================================
MACHINE_FEATURES += "splashscreen"
MACHINE_FEATURES += "watchdog"
MACHINE_FEATURES += "bluetooth"
MACHINE_FEATURES += "wifi"
MACHINE_FEATURES += "${@'gpu' if d.getVar('ACCEPT_EULA_'+d.getVar('MACHINE')) == '1' else ''}"
MACHINE_FEATURES += "m4copro"

# Bluetooth
BLUETOOTH_LIST += "linux-firmware-bluetooth-bcm43xx"
# Wifi
WIFI_LIST += "linux-firmware-bcm4373"

#Driver for PAN9028
MACHINE_FEATURES += "nxp8987-sdio"
MACHINE_EXTRA_RRECOMMENDS:append = " ${@bb.utils.contains('MACHINE_FEATURES', 'nxp8987-sdio', 'kernel-module-nxp-wlan', '', d)}"
WIFI_LIST += "firmware-nxp-wifi-nxp8987-sdio"
# =========================================================================
# Kernel
# =========================================================================
# For eval board: auto-load goodix module (touchscreen module)
#KERNEL_MODULE_AUTOLOAD = "goodix"

# Define the devicetree for Linux A7 examples
#LINUX_A7_EXAMPLES_DT += "stm32mp157c-dk2-a7-examples"
#LINUX_A7_EXAMPLES_DT += "stm32mp157c-ev1-a7-examples"
LINUX_A7_EXAMPLES_DT += "stm32mp157f-dk2-a7-examples"
#LINUX_A7_EXAMPLES_DT += "stm32mp157f-ev1-a7-examples"

# =========================================================================
# M4 copro
# =========================================================================
# Define the devicetree for M4 example
#CUBE_M4_EXAMPLES_DT += "stm32mp157c-dk2-m4-examples"
#CUBE_M4_EXAMPLES_DT += "stm32mp157c-ev1-m4-examples"
CUBE_M4_EXAMPLES_DT += "stm32mp157f-dk2-m4-examples"
#CUBE_M4_EXAMPLES_DT += "stm32mp157f-ev1-m4-examples"

# Define specific board reference to use
# For M4 BOARD config, STM32MP157C are similar to STM32MP157F
M4_BOARDS = "STM32MP157C-DK2"

# =========================================================================
# OPTEE
# =========================================================================
# For sdk generation, declare the default board configuration to use.
ST_OPTEE_EXPORT_TA_REF_BOARD:stm32mp1common = "stm32mp157f-dk2.dts"

# =========================================================================
# extlinux configuration
# =========================================================================
# As example, modify the default boot config to M4 config
#UBOOT_EXTLINUX_DEFAULT_LABEL:stm32mp157c-dk2 = "stm32mp157c-dk2-m4-examples"

# =========================================================================
# WIC for sdcard raw image
# =========================================================================
WIC_CREATE_EXTRA_ARGS = "--no-fstab-update"
WKS_FILE_DEPENDS ?= " \
    virtual/bootloader \
    virtual/trusted-firmware-a \
    ${@bb.utils.contains('BOOTSCHEME_LABELS', 'optee', 'virtual-optee-os', '', d)} \
    ${@bb.utils.contains('ST_BOOTFS','1','st-image-bootfs', '', d)} \
    ${@bb.utils.contains('ST_VENDORFS','1','st-image-vendorfs', '', d)} \
    ${@bb.utils.contains('ST_USERFS','1','st-image-userfs', '', d)} \
"
OPTEE_WIC_FILE = "${@bb.utils.contains('ST_VENDORFS','1','sdcard-stm32mp157f-dk2-optee-vendorfs-1GB.wks.in','sdcard-stm32mp157f-dk2-optee-1GB.wks.in',d)}"

# for generated a WIC file, please uncomment the 2 following lines or add them to local.conf
#WKS_IMAGE_FSTYPES += "wic wic.bz2 wic.bmap"
#WKS_FILE += "${OPTEE_WIC_FILE}"

# ========================================================================
# NAND partition sizes
# ========================================================================
#STM32MP_BOOTFS_SIZE = "32768"
#STM32MP_ROOTFS_SIZE:nand_4_256_1024 = "327680"
#STM32MP_USERFS_SIZE = "75536"
#STM32MP_VENDORFS_SIZE = "16384"

# for multivolume
ST_USERFS = "0"
ST_VENDORFS = "0"

# meta-summit-radio is in bblayers and summit-supplicant also PROVIDES wpa-supplicant:
# pin the upstream OE recipe for this machine (NXP 8987 Wi-Fi, no Summit radio)
PREFERRED_PROVIDER_wpa-supplicant = "wpa-supplicant"
PREFERRED_RPROVIDER_wpa-supplicant = "wpa-supplicant"
PREFERRED_RPROVIDER_wpa-supplicant-cli = "wpa-supplicant"
PREFERRED_RPROVIDER_wpa-supplicant-passphrase = "wpa-supplicant"
PREFERRED_RPROVIDER_wpa-supplicant-lib = "wpa-supplicant"


###### extlinux #######
UBOOT_EXTLINUX_DEFAULT_LABEL = "evb_yes7"

UBOOT_EXTLINUX_LABELS:target-sdcard = "microdev_yes7"
UBOOT_EXTLINUX_LABELS:target-nand = "microdev_yes7"
UBOOT_EXTLINUX_FDT:microdev_yes7 = "/stm32mp157a-ugea-microdev-mx.dtb"

UBOOT_EXTLINUX_LABELS:target-sdcard += "evb_yes7"
UBOOT_EXTLINUX_LABELS:target-nand += "evb_yes7"
UBOOT_EXTLINUX_FDT:evb_yes7 = "/stm32mp157a-ugea-evb.dtb"
```
